## boards/framework/framework_wireless_dongle/Kconfig.defconfig
```kconfig
# Copyright (c) 2026 Framework Computer Inc
# SPDX-License-Identifier: Apache-2.0

if BOARD_FRAMEWORK_WIRELESS_DONGLE_NRF54LM20A_CPUAPP

config HW_STACK_PROTECTION
	default ARCH_HAS_STACK_PROTECTION

endif # BOARD_FRAMEWORK_WIRELESS_DONGLE_NRF54LM20A_CPUAPP
```

## boards/framework/framework_wireless_dongle/Kconfig.framework_wireless_dongle
```kconfig
# Copyright (c) 2026 Framework Computer Inc
# SPDX-License-Identifier: Apache-2.0

config BOARD_FRAMEWORK_WIRELESS_DONGLE
	select SOC_NRF54LM20A_CPUAPP if BOARD_FRAMEWORK_WIRELESS_DONGLE_NRF54LM20A_CPUAPP
```

## boards/framework/framework_wireless_dongle/board.yml
```yaml
board:
  name: framework_wireless_dongle
  full_name: Framework Wireless Dongle
  vendor: framework
  socs:
  - name: nrf54lm20a
runners:
  run_once:
    '--recover':
    - runners:
      - nrfjprog
      - nrfutil
      run: first
      groups:
      - boards:
        - framework_wireless_dongle/nrf54lm20a/cpuapp
    '--erase':
    - runners:
      - nrfjprog
      - jlink
      - nrfutil
      run: first
      groups:
      - boards:
        - framework_wireless_dongle/nrf54lm20a/cpuapp
    '--reset':
    - runners:
      - nrfjprog
      - jlink
      - nrfutil
      run: last
      groups:
      - boards:
        - framework_wireless_dongle/nrf54lm20a/cpuapp
```

## boards/framework/framework_wireless_tp_kb/Kconfig.framework_wireless_tp_kb
```kconfig
# Copyright (c) 2026 Framework Computer Inc
# SPDX-License-Identifier: Apache-2.0

config BOARD_FRAMEWORK_WIRELESS_TP_KB
	select SOC_NRF54LM20A_CPUAPP if BOARD_FRAMEWORK_WIRELESS_TP_KB_NRF54LM20A_CPUAPP
```

## boards/framework/framework_wireless_tp_kb/board.yml
```yaml
board:
  name: framework_wireless_tp_kb
  full_name: Framework Wireless Touchpad Keyboard
  vendor: framework
  socs:
  - name: nrf54lm20a
runners:
  run_once:
    '--recover':
    - runners:
      - nrfjprog
      - nrfutil
      run: first
      groups:
      - boards:
        - framework_wireless_tp_kb/nrf54lm20a/cpuapp
    '--erase':
    - runners:
      - nrfjprog
      - jlink
      - nrfutil
      run: first
      groups:
      - boards:
        - framework_wireless_tp_kb/nrf54lm20a/cpuapp
    '--reset':
    - runners:
      - nrfjprog
      - jlink
      - nrfutil
      run: last
      groups:
      - boards:
        - framework_wireless_tp_kb/nrf54lm20a/cpuapp
```

## drivers/led/Kconfig.is31fl3741
```kconfig
# Copyright 2023 Daniel DeGrasse <daniel@degrasse.com>
# Copyright 2025-2026 Framework Computer Inc
# SPDX-License-Identifier: Apache-2.0

config IS31FL3741
	bool "IS31FL3741 LED driver"
	default y
	depends on DT_HAS_ISSI_IS31FL3741_ENABLED
	select I2C
	help
	  Enable LED driver for IS31FL3741.
	  IS31FL3741 is a matrix LED driver, capable of a maximum of 3.75 mA
	  per LED, or 38 mA total across all LEDs in the 39x9 dot matrix.
```

## drivers/led_strip/Kconfig.led_to_led_strip
```kconfig
config LED_TO_LED_STRIP
    bool "LED to LED Strip Adapter"
    default y
    depends on DT_HAS_LED_TO_LED_STRIP_ENABLED
    help
      Enable the adapter that maps the LED API to the LED Strip API.
```

## dts/bindings/led/issi,is31fl3741.yaml
```yaml
# Copyright 2023 Daniel DeGrasse <daniel@degrasse.com>
# Copyright 2025 Framework Computer Inc
# SPDX-License-Identifier: Apache-2.0
description: ISSI IS31FL3741 LED Matrix Driver

compatible: "issi,is31fl3741"

include: "i2c-device.yaml"

properties:
  sdb-gpios:
    type: phandle-array
    description: |
      Hardware shutdown pin. If routed on the board, this property must be
      present. Set to a logical 1 at boot to exit the device from hardware
      shutdown.

  pwm-frequency:
    type: int
    default: 29000
    description: |
      PWM frequency used to drive the LEDs.

  current-limit:
    type: int
    default: 0xFF
    description: |
      Global current limit. Sets the global current control register of LED
      driver (set table 14). Limits global current based on the following
      formula: (840/R_ISET) * (current-limit/256). Defaults to max value
      of 0xFF, so led output will still be enabled if property is
      not provided.

  current-sources:
    type: int
    default: 9
    enum:
      - 9
      - 8
      - 7
      - 6
      - 5
      - 4
      - 3
      - 2
      - 0
    description: |
      Control which rows are active, default all.
```

## samples/drivers/led/is31fl3741/Kconfig
```kconfig
# SPDX-License-Identifier: Apache-2.0
# Copyright 2023 Daniel DeGrasse <daniel@degrasse.com>
# Copyright 2025-2026 Framework Computer Inc

source "Kconfig.zephyr"

config LED_ROW_COUNT
	int "Number of rows in IS31FL3741 matrix"
	default 9
	help
	  Set this to match the number of SW LED sink connections
	  wired up to your IS31FL3741 LED driver. The sample will only attempt
	  to drive LEDs within this range.

config LED_COLUMN_COUNT
	int "Number of columns in IS31FL3741 matrix"
	default 39
	help
	  Set this to match the number of CS LED source connections wired up
	  to your IS31FL3741 LED driver. The sample will only attempt to drive
	  LEDs within this range.
```

## samples/drivers/led/is31fl3741/boards/framework_ledmatrix.conf
```kconfig
# SPDX-License-Identifier: Apache-2.0
# Copyright 2025-2026 Framework Computer Inc
CONFIG_LED_ROW_COUNT=9
CONFIG_LED_COLUMN_COUNT=34
```

## samples/drivers/led/is31fl3741/sample.yaml
```yaml
sample:
  description: Demonstration of the IS31FL3741 LED driver
  name: IS31FL3741 sample
tests:
  sample.drivers.led.is31fl3741:
    filter: dt_compat_enabled("issi,is31fl3741")
    tags: LED
    depends_on: i2c
    integration_platforms:
      - framework_ledmatrix
```
