## CMakeLists.txt
```
# SPDX-License-Identifier: Apache-2.0

cmake_minimum_required(VERSION 3.13.1)
include($ENV{ZEPHYR_BASE}/cmake/app/boilerplate.cmake NO_POLICY_SCOPE)

set(BOARD stm32g071rb_disco)
project(stm32g071rb_disco)


target_sources(app PRIVATE src/main.c)
```

## sample.yaml
```
sample:
  name: Board peripherals for st_stm32g071rb_disco usb c board
tests:
  sample.board.st_stm32g071rb_disco:
    platform_whitelist: st_stm32g071rb_disco
    tags: board
```

## prj.conf
```kconfig
CONFIG_BOOT_BANNER=y
CONFIG_SERIAL=y
CONFIG_UART_STM32=y
CONFIG_UART_3=y
CONFIG_UART_INTERRUPT_DRIVEN=y
CONFIG_OPENOCD_SUPPORT=y

CONFIG_SHELL=y
CONFIG_SHELL_BACKENDS=y
CONFIG_SHELL_BACKEND_SERIAL=y
CONFIG_SHELL_PROMPT_UART="frame:~$ "
CONFIG_UART_SHELL_ON_DEV_NAME="UART_3"
CONFIG_SHELL_BACKEND_SERIAL_INTERRUPT_DRIVEN=y
CONFIG_SHELL_BACKEND_SERIAL_TX_RING_BUFFER_SIZE=8
CONFIG_SHELL_BACKEND_SERIAL_RX_RING_BUFFER_SIZE=64
CONFIG_SHELL_BACKEND_SERIAL_LOG_MESSAGE_QUEUE_TIMEOUT=100
CONFIG_SHELL_BACKEND_SERIAL_LOG_MESSAGE_QUEUE_SIZE=10
CONFIG_SHELL_BACKEND_SERIAL_LOG_LEVEL_DEFAULT=y
CONFIG_SHELL_BACKEND_SERIAL_LOG_LEVEL_DBG=y
CONFIG_SHELL_STACK_SIZE=2048
CONFIG_SHELL_BACKSPACE_MODE_DELETE=y
CONFIG_SHELL_CMD_BUFF_SIZE=32
CONFIG_SHELL_PRINTF_BUFF_SIZE=30
CONFIG_SHELL_ARGC_MAX=12
CONFIG_SHELL_WILDCARD=y
CONFIG_SHELL_ECHO_STATUS=y
CONFIG_SHELL_METAKEYS=y
CONFIG_SHELL_HELP=y
CONFIG_SHELL_HELP_ON_WRONG_ARGUMENT_COUNT=y
CONFIG_SHELL_HISTORY=y
CONFIG_SHELL_HISTORY_BUFFER=512
CONFIG_SHELL_STATS=y
CONFIG_SHELL_CMDS=y
CONFIG_SHELL_CMDS_RESIZE=y
CONFIG_KERNEL_SHELL=y
CONFIG_DEVICE_SHELL=y
```

## src/main.c
```c
#include <zephyr.h>
#include <device.h>
#include <sys/printk.h>

#include <drivers/gpio.h>

#include <display/cfb.h>

#include <shell/shell.h>
#include <shell/shell_uart.h>
#include <version.h>

void main(void)
{
        struct device *dev;
        bool led_is_on = true;
        int ret;

        dev = device_get_binding(DT_ALIAS_LED0_GPIOS_CONTROLLER);
        if (dev == NULL) {
                return;
        }

        ret = gpio_pin_configure(dev, DT_ALIAS_LED0_GPIOS_PIN,
                                 GPIO_OUTPUT_ACTIVE
                                 | DT_ALIAS_LED0_GPIOS_FLAGS);
        if (ret < 0) {
                return;
        }

        while (1) {
                gpio_pin_set(dev, DT_ALIAS_LED0_GPIOS_PIN, (int)led_is_on);
                led_is_on = !led_is_on;
                k_sleep(SLEEP_TIME_MS);
        }
}
```
